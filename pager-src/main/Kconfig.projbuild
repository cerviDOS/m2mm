## pager-src/main/Kconfig.projbuild
```kconfig
menu "Wi-Fi Credentials"

    config WIFI_SSID
        string "SSID"
        default "UNKNOWN"
        help
            Network name.

    config WIFI_PASSWORD
        string "Password"
        default "UNKNOWN"

endmenu
```
